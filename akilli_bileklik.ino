#include <Arduino.h>
#include <U8g2lib.h>
#include <HTTPClient.h>
#include <Wire.h>
#include <WiFi.h>
#include "MAX30100_PulseOximeter.h"
#define MPU6050_ACCEL_XOUT_H 0x3B 
#define MPU6050_PWR_MGMT_1 0x6B 
#define MPU6050_PWR_MGMT_2 0x6C 
#define MPU6050_WHO_AM_I 0x75 
#define MPU6050_I2C_ADDRESS 0x68
#define SWAP(x,y) swap = x; x = y; y = swap

//U8G2_SH1106_128X32_VISIONOX_F_HW_I2C u8g2(U8G2_R0, /* reset=*/ U8X8_PIN_NONE); 
U8G2_SH1106_128X64_NONAME_F_HW_I2C u8g2(U8G2_R0, /* reset=*/ U8X8_PIN_NONE);
//U8G2_SH1106_128X64_NONAME_HW_I2C u8g2(U8G2_R0,/* reset=*/ U8X8_PIN_NONE);

const char *ssid  = "DESKTOP-14JK4CN";
const char *pass = "wifiid";
char ssidtel[]  = "Geme4";
const char* passtel = "wifipass";

#define REPORTING_PERIOD_MS     1000
#define WIFI_TIMEOUT_MS 20000

typedef union accel_t_gyro_union
{
  struct
  {
    uint8_t x_accel_h;
    uint8_t x_accel_l;
    uint8_t y_accel_h;
    uint8_t y_accel_l;
    uint8_t z_accel_h;
    uint8_t z_accel_l;
    uint8_t t_h;
    uint8_t t_l;
    uint8_t x_gyro_h;
    uint8_t x_gyro_l;
    uint8_t y_gyro_h;
    uint8_t y_gyro_l;
    uint8_t z_gyro_h;
    uint8_t z_gyro_l;
  } reg;
  struct
  {
    int16_t x_accel;
    int16_t y_accel;
    int16_t z_accel;
    int16_t temperature;
    int16_t x_gyro;
    int16_t y_gyro;
    int16_t z_gyro;
  } value;
};

unsigned long last_read_time;
float         last_x_angle;  // These are the filtered angles
float         last_y_angle;
float         last_z_angle; 
float         last_gyro_x_angle;  // Store the gyro angles to compare drift
float         last_gyro_y_angle;
float         last_gyro_z_angle;

void set_last_read_angle_data(unsigned long time, float x, float y, float z, float x_gyro, float y_gyro, float z_gyro) {
  last_read_time = time;
  last_x_angle = x;
  last_y_angle = y;
  last_z_angle = z;
  last_gyro_x_angle = x_gyro;
  last_gyro_y_angle = y_gyro;
  last_gyro_z_angle = z_gyro;
}

inline unsigned long get_last_time() {return last_read_time;}
inline float get_last_x_angle() {return last_x_angle;}
inline float get_last_y_angle() {return last_y_angle;}
inline float get_last_z_angle() {return last_z_angle;}
inline float get_last_gyro_x_angle() {return last_gyro_x_angle;}
inline float get_last_gyro_y_angle() {return last_gyro_y_angle;}
inline float get_last_gyro_z_angle() {return last_gyro_z_angle;}

float    base_x_accel;
float    base_y_accel;
float    base_z_accel;
float    base_x_gyro;
float    base_y_gyro;
float    base_z_gyro;

int read_gyro_accel_vals(uint8_t* accel_t_gyro_ptr) {
 
  accel_t_gyro_union* accel_t_gyro = (accel_t_gyro_union *) accel_t_gyro_ptr;
  
  int error = MPU6050_read (MPU6050_ACCEL_XOUT_H, (uint8_t *) accel_t_gyro, sizeof(*accel_t_gyro));

  uint8_t swap;

  SWAP ((*accel_t_gyro).reg.x_accel_h, (*accel_t_gyro).reg.x_accel_l);
  SWAP ((*accel_t_gyro).reg.y_accel_h, (*accel_t_gyro).reg.y_accel_l);
  SWAP ((*accel_t_gyro).reg.z_accel_h, (*accel_t_gyro).reg.z_accel_l);
  SWAP ((*accel_t_gyro).reg.t_h, (*accel_t_gyro).reg.t_l);
  SWAP ((*accel_t_gyro).reg.x_gyro_h, (*accel_t_gyro).reg.x_gyro_l);
  SWAP ((*accel_t_gyro).reg.y_gyro_h, (*accel_t_gyro).reg.y_gyro_l);
  SWAP ((*accel_t_gyro).reg.z_gyro_h, (*accel_t_gyro).reg.z_gyro_l);

  return error;
}

void calibrate_sensors() {
  int                   num_readings = 10;
  float                 x_accel = 0;
  float                 y_accel = 0;
  float                 z_accel = 0;
  float                 x_gyro = 0;
  float                 y_gyro = 0;
  float                 z_gyro = 0;
  accel_t_gyro_union    accel_t_gyro;
 
  read_gyro_accel_vals((uint8_t *) &accel_t_gyro);
 
  for (int i = 0; i < num_readings; i++) {
    read_gyro_accel_vals((uint8_t *) &accel_t_gyro);
    x_accel += accel_t_gyro.value.x_accel;
    y_accel += accel_t_gyro.value.y_accel;
    z_accel += accel_t_gyro.value.z_accel;
    x_gyro += accel_t_gyro.value.x_gyro;
    y_gyro += accel_t_gyro.value.y_gyro;
    z_gyro += accel_t_gyro.value.z_gyro;
    delay(100);
  }
  x_accel /= num_readings;
  y_accel /= num_readings;
  z_accel /= num_readings;
  x_gyro /= num_readings;
  y_gyro /= num_readings;
  z_gyro /= num_readings;

  base_x_accel = x_accel;
  base_y_accel = y_accel;
  base_z_accel = z_accel;
  base_x_gyro = x_gyro;
  base_y_gyro = y_gyro;
  base_z_gyro = z_gyro;

}

const unsigned char borsalogo [] PROGMEM = {
  0xFF, 0xFF, 0xBF, 0xD9, 0xB6, 0x03, 0xFF, 0xFF, 0xF7, 0xBF, 0xDF, 0x01, 
  0xFF, 0xFF, 0xFF, 0xFB, 0xD6, 0x01, 0xFF, 0x3F, 0xE0, 0xDF, 0x7F, 0x03, 
  0xFF, 0x3F, 0xA0, 0xFE, 0x5F, 0x01, 0xFF, 0x3F, 0xE0, 0x97, 0xF9, 0x03, 
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  0xFF, 0xFF, 0xFF, 0xFF, 0xFF, 0x03, 0xFF, 0xFF, 0xFF, 0xFF, 0xFF, 0x03,      };

const unsigned char ayarlarlogo [] PROGMEM = {
 0x00, 0x00, 0x00, 0x00, 0x00, 0x00, 0x00, 0x00, 0x10, 0x00, 0x00, 0x00, 
  0x00, 0x00, 0xFC, 0x00, 0x00, 0x00, 0x00, 0x00, 0xFC, 0x00, 0x00, 0x00, 
  0x00, 0x00, 0xFE, 0x00, 0x00, 0x00, 0x00, 0x00, 0xFE, 0x01, 0x00, 0x00, 
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  0x00, 0x00, 0x20, 0x00, 0x00, 0x00, 0x00, 0x00, 0x00, 0x00, 0x00, 0x00,     };


const unsigned char alarmlogo [] PROGMEM = {
   0x00, 0x00, 0x00, 0x00, 0x00, 0x00, 0x00, 0x00, 0x00, 0x00, 0x00, 0x00, 
  0x00, 0x00, 0x00, 0x00, 0x00, 0x00, 0x00, 0x00, 0x00, 0x00, 0x00, 0x00, 
  0x00, 0x00, 0x00, 0x00, 0x00, 0x00, 0x00, 0x00, 0x00, 0x00, 0x00, 0x00, 
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  0x00, 0x00, 0x00, 0x00, 0x00, 0x00, 0x00, 0x00, 0x00, 0x00, 0x00, 0x00,      };

const unsigned char nabizlogo [] PROGMEM = {
  0x00, 0x00, 0x00, 0x00, 0x00, 0x00, 0x00, 0x00, 0x00, 0x00, 0x00, 0x00, 
  0x00, 0x00, 0x00, 0x00, 0x00, 0x00, 0x00, 0x00, 0x00, 0x00, 0x00, 0x00, 
  0x00, 0x00, 0x00, 0x00, 0x00, 0x00, 0x00, 0x00, 0x00, 0x00, 0x00, 0x00, 
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  0x00, 0x00, 0x00, 0x00, 0x00, 0x00, 0x00, 0x00,    };

const unsigned char oksijenlogo [] PROGMEM = {
  0x00, 0x00, 0x00, 0x00, 0x00, 0x00, 0x00, 0x00, 0x00, 0x00, 0x00, 0x00, 
  0x00, 0x00, 0x00, 0x00, 0x00, 0x00, 0x00, 0x00, 0x00, 0x00, 0x00, 0x00, 
  0x00, 0x00, 0x00, 0x00, 0x00, 0x00, 0x00, 0xF8, 0x01, 0x00, 0x00, 0x00, 
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  0x00, 0x00, 0x00, 0x00, 0x00, 0x00, 0x00, 0x00, 0x00, 0x00, 0x00, 0x00,       };

const unsigned char hakkindalogo [] PROGMEM = {
  0x00, 0x00, 0xFF, 0x01, 0x00, 0x00, 0x00, 0xE0, 0xFF, 0x1F, 0x00, 0x00, 
  0x00, 0xF8, 0xFF, 0x7F, 0x00, 0x00, 0x00, 0xFE, 0xFF, 0xFF, 0x01, 0x00, 
  0x00, 0xFF, 0xFF, 0xFF, 0x03, 0x00, 0x80, 0xFF, 0xEF, 0xFF, 0x07, 0x00, 
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  0x00, 0xE0, 0xFF, 0x1F, 0x00, 0x00, 0x00, 0x00, 0xFE, 0x03, 0x00, 0x00,       };

const unsigned char alarmlogoanaekran [] PROGMEM = {
  0x48, 0x00, 0xFC, 0x00, 0x58, 0x00, 0x40, 0x00, 0x04, 0x00, 0xA4, 0x00, 
  0x80, 0x00, 0x08, 0x00, 0x48, 0x00, 0x30, 0x00, };

const unsigned char wifilogo [] PROGMEM = {
  0x00, 0x00, 0x38, 0x00, 0xE8, 0x00, 0xB4, 0x00, 0x58, 0x00, 0x78, 0x00, 
  0x30, 0x00, 0x00, 0x00, 0x00, 0x00, 0x00, 0x00,   };

const unsigned char adimlogo [] PROGMEM = {
  0x00, 0x00, 0x00, 0x00, 0x00, 0x00, 0x00, 0x00, 0x00, 0x00, 0x00, 0x00, 
  0x00, 0x00, 0x00, 0x00, 0x00, 0x00, 0x00, 0x00, 0x00, 0x00, 0x00, 0x00, 
  0x00, 0x00, 0x00, 0x00, 0x00, 0x00, 0x00, 0x00, 0x00, 0x00, 0x00, 0x00, 
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  0x00, 0x00, 0x00, 0x00, 0x00, 0x00, 0x00, 0x00, 0x00, 0x00, 0x00, 0x00,  };

const unsigned char sicakliklogo [] PROGMEM = {
  0x00, 0x00, 0x00, 0x00, 0x00, 0x00, 0x00, 0x00, 0x00, 0x00, 0x00, 0x00, 
  0x00, 0x00, 0x00, 0x00, 0x00, 0x00, 0x00, 0x00, 0x00, 0x00, 0x00, 0x00, 
  0x00, 0x00, 0x00, 0x00, 0x00, 0x00, 0x00, 0x00, 0xF8, 0x00, 0x00, 0x00, 
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  0x00, 0x00, 0x00, 0x00, 0x00, 0x00, 0x00, 0x00, 0x00, 0x00, 0x00, 0x00,     };

const unsigned char alarmbuyuk [] PROGMEM = {
0x00, 0x00, 0x00, 0x00, 0x00, 0x00, 0x00, 0x00, 0x00, 0x00, 0x00, 0x00, 
  0x00, 0x00, 0x00, 0x00, 0x00, 0x00, 0x00, 0x00, 0x00, 0x00, 0x00, 0x00, 
  0x00, 0x00, 0x00, 0x00, 0x00, 0x00, 0x00, 0x00, 0x00, 0x00, 0x00, 0x00, 
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  0x00, 0x00, 0x00, 0x00, };

const unsigned char bitcoinlogo [] PROGMEM = {
  0x00, 0x00, 0x00, 0x00, 0x00, 0x00, 0x00, 0x00, 0x00, 0x00, 0x00, 0x00, 
  0x00, 0x00, 0x00, 0x00, 0x00, 0x00, 0x00, 0x00, 0x00, 0x00, 0x00, 0x00, 
  0x00, 0x00, 0xC0, 0x0C, 0x00, 0x00, 0x00, 0xC0, 0x0E, 0x00, 0x00, 0x00, 
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  0x00, 0x00, 0x00, 0x00, 0x00, 0x00, 0x00, 0x00, 0x00, 0x00, 0x00, 0x00,     };
  
const unsigned char dolarlogo [] PROGMEM = {
  0x00, 0x00, 0x0F, 0x00, 0x00, 0x00, 0x00, 0x0F, 0x00, 0x00, 0x00, 0x00, 
  0x0F, 0x00, 0x00, 0x00, 0x00, 0x0F, 0x00, 0x00, 0x00, 0xE0, 0x7F, 0x00, 
  0x00, 0x00, 0xF8, 0xFF, 0x00, 0x00, 0x00, 0xFC, 0xFF, 0x01, 0x00, 0x00, 
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  0x00, 0x00, 0x00, 0x00, 0x0F, 0x00, 0x00, 0x00, 0x00, 0x0F, 0x00, 0x00,      };
  
const unsigned char ethlogo [] PROGMEM = {
    0x00, 0x00, 0x00, 0x00, 0x00, 0x00, 0x00, 0x00, 0x00, 0x00, 0x00, 0x00, 
  0x00, 0x00, 0x00, 0x00, 0x00, 0x00, 0x00, 0x00, 0x00, 0x00, 0x00, 0x00, 
  0x00, 0x00, 0x00, 0x00, 0x00, 0x00, 0x00, 0x00, 0x04, 0x00, 0x00, 0x00, 
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  0x00, 0x00, 0x00, 0x00, 0x00, 0x00, 0x00, 0x00, 0x00, 0x00, 0x00, 0x00,      };

const unsigned char bist100logo [] PROGMEM = {
  0xFF, 0xFF, 0xFF, 0xFF, 0x0F, 0xFF, 0xFF, 0xFF, 0xFF, 0x0F, 0xFF, 0xFF, 
  0xFE, 0xFF, 0x0F, 0xFF, 0x0F, 0x80, 0xFF, 0x0F, 0xFF, 0x03, 0x00, 0xFE, 
  0x0F, 0xFF, 0x00, 0x30, 0xF8, 0x0F, 0x7F, 0x00, 0x38, 0xF0, 0x0F, 0x3F, 
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  0xFF, 0x0F, 0xFF, 0xFF, 0xFF, 0xFF, 0x0F, 0xFF, 0xFF, 0xFF, 0xFF, 0x0F,    };
  
const unsigned char eurologo [] PROGMEM = {
  0x00, 0x00, 0x00, 0x00, 0x00, 0x00, 0x00, 0x00, 0x00, 0x00, 0x00, 0x00, 
  0x00, 0x00, 0x00, 0x00, 0x00, 0xFC, 0x01, 0x00, 0x00, 0x00, 0xFF, 0x03, 
  0x00, 0x00, 0xC0, 0xFF, 0x03, 0x00, 0x00, 0xE0, 0xFF, 0x03, 0x00, 0x00, 
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  0x01, 0x00, 0x00, 0x00, 0x50, 0x00, 0x00, 0x00, 0x00, 0x00, 0x00, 0x00,    };
    
const unsigned char altinlogo [] PROGMEM = {
  0x00, 0x00, 0x00, 0x00, 0x00, 0x00, 0x00, 0x00, 0x00, 0x00, 0x00, 0x10, 
  0x00, 0x00, 0x00, 0x00, 0x10, 0x00, 0x00, 0x00, 0x40, 0x10, 0x00, 0x00, 
  0x00, 0xC0, 0x10, 0x00, 0x00, 0x00, 0x80, 0x10, 0x00, 0x00, 0x00, 0x80, 
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  0x00, 0x00, 0x00, 0x00, 0x00, 0x00, 0x00, 0x00, 0x00, 0x00, 0x00, 0x00,    };

const unsigned char gumuslogo [] PROGMEM = {
  0x00, 0x00, 0x00, 0x00, 0x00, 0x00, 0x00, 0x00, 0x00, 0x00, 0x00, 0x00, 
  0x00, 0x00, 0x00, 0x00, 0x00, 0x00, 0x00, 0x00, 0x00, 0x00, 0x00, 0x00, 
  0x00, 0x00, 0x00, 0x00, 0x00, 0x00, 0x00, 0x80, 0x04, 0x00, 0x00, 0x00, 
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  0x00, 0x00, 0x00, 0x00, 0x00, 0x00, 0x00, 0x00, 0x00, 0x00, 0x00, 0x00,    };
  
const unsigned char nabizlogoanaekran [] PROGMEM = {
    0x00, 0x00, 0x00, 0x00, 0x00, 0x00, 0x00, 0x00, 0xC0, 0x00, 0x40, 0x00, 
  0xE0, 0x00, 0xF8, 0x26, 0xBC, 0x3F, 0xA0, 0x05, 0x80, 0x01, 0x00, 0x01, 
  0x00, 0x00, 0x00, 0x00, 0x00, 0x00, 0x00, 0x00,   };

const unsigned char adimlogoanaekran [] PROGMEM = {
  0x00, 0x00, 0x00, 0x00, 0x00, 0x00, 0x00, 0x00, 0x00, 0x00, 0x00, 0x02, 
  0x00, 0x0F, 0xF0, 0x1E, 0x18, 0x10, 0x78, 0x3B, 0xE0, 0x0B, 0x00, 0x00, 
  0x00, 0x00, 0x00, 0x00, 0x00, 0x00, 0x00, 0x00,   };

const unsigned char tllogo [] PROGMEM = {
    0x10, 0x00, 0x30, 0x00, 0x30, 0x00, 0xB0, 0x03, 0xF0, 0x02, 0xBC, 0x03, 
  0xF6, 0x00, 0x3C, 0x00, 0x34, 0x18, 0x30, 0x0C, 0x30, 0x0C, 0x30, 0x04, 
  0x30, 0x06, 0xB0, 0x03, 0xF0, 0x01, 0x20, 0x00,   };

const String urlbist100 = "https://api.thingspeak.com/apps/thinghttp/send_request?api_key=LQ15TAJ4DNB76Y68";
const String urlbtc = "https://api.thingspeak.com/apps/thinghttp/send_request?api_key=13VEXPDDZUW4XG84";
const String urleth = "https://api.thingspeak.com/apps/thinghttp/send_request?api_key=2JEYM4ZX6U6R8WK6";
const String urlaltinons = "https://api.thingspeak.com/apps/thinghttp/send_request?api_key=QSJHW5WAM9DGTD1N";
const String urlaltingram = "https://api.thingspeak.com/apps/thinghttp/send_request?api_key=K2GY2POTQE2QAFV3";
const String urlgumusons = "https://api.thingspeak.com/apps/thinghttp/send_request?api_key=OXKD75KBMEH0UI9S";
const String urlgumusgram = "https://api.thingspeak.com/apps/thinghttp/send_request?api_key=IZU82F82LG3JW4D9";
const String urleuro = "https://api.thingspeak.com/apps/thinghttp/send_request?api_key=32VUN65F4BTE839M";
const String urldolar = "https://api.thingspeak.com/apps/thinghttp/send_request?api_key=2LWZF1WRXHKS4V9T";
float bist1001;
float btc1;
float eth1;
float altinons1;
float altingram1;
float gumusons1;
float gumusgram1;
float euro1;
float dolar1;

PulseOximeter pox;
uint32_t tsLastReport = 0;
int alarmaktif =1;
int alarmSaat = 1;
int alarmDakika = 25;
int Saat = 13;
int Dakika = 49;
int Saniye = 0;
int Gun = 1;
int Ay = 5;
int Yil = 2022;
int Aygunu = 23;
int i = 0;
int k;
String gunler[]={"x","Pazartesi", "Sali", "Carsamba", "Persembe","Cuma","Cumartesi","Pazar"};
String aylar[]={
"x","Ocak","Subat","Mart","Nisan","Mayis","Hazrn","Temmz","Agsts",
"Eylul","Ekim","Kasım","Arlık"};
float x,y,z;
int count=0,prev=0;
int threshold=3;
int tempe;

// Değişkenler...
byte Menu = 0;
bool Flip = false;
byte Contrast = 1;
// Butonlar...
#define Left_In  23
#define Ok_In    17
#define Right_In 19
#define Geri_In 16
byte Left, Ok, Right,Geri;

void setup(void) {
  Serial.begin(115200);
  Serial.println("1asdasdas");
  //WiFi.begin(ssid, pass);
  // Butonlar İnput Olarak Ayarlandı...
  Serial.println("ibo");
  xTaskCreate(saathesaplama,"saathesaplama",1000,NULL,1,NULL);
  Serial.println("2");
  //xTaskCreate(tempe,"sicaklik",1000,NULL,2,NULL);
  xTaskCreate(keepWiFiAlive,"keep wifi alive",2000,NULL,2,NULL);
  //xTaskCreatePinnedToCore(Task1code,"Task1",10000,NULL,1,&Task1,0);     
  //xTaskCreatePinnedToCore(Task2code,"Task2",50000,NULL,1,&Task2,1); 
  //xTaskCreate(Mpu6050,"mpu6050",50000,NULL,1,NULL);
  //xTaskCreate(alert,"alert",5000,NULL,1,NULL);
  //xTaskCreate(butonoku,"alert",500,NULL,1,NULL);
  pinMode(Left_In,   INPUT);
  pinMode(Ok_In,     INPUT);
  pinMode(Right_In,  INPUT);
  pinMode(Geri_In,  INPUT);
  Serial.println("mertcan");
  // Max30100 Başlatılıyor
  Serial.print("Initializing pulse oximeter..");
    if (!pox.begin()) {
        Serial.println("FAILED");
        for(;;);
    } else {
        Serial.println("SUCCESS");
    }
    pox.setOnBeatDetectedCallback(onBeatDetected);
    
  //MPU6050
    int error;
  uint8_t c;
  Serial.begin(115200);
  Wire.begin();
  error = MPU6050_read (MPU6050_WHO_AM_I, &c, 1);
  error = MPU6050_read (MPU6050_PWR_MGMT_2, &c, 1);
  MPU6050_write_reg (MPU6050_PWR_MGMT_1, 0);
 
  calibrate_sensors(); 
  set_last_read_angle_data(millis(), 0, 0, 0, 0, 0, 0);
  // u8g2 Başlatılıyor
  u8g2.begin();
  u8g2.setFlipMode(Flip);
  u8g2.setContrast(Contrast);
  //u8g2.setFont(u8g2_font_crox2tb_tf);
  u8g2.setFont(u8g2_font_unifont_t_symbols);
  u8g2.setFontRefHeightExtendedText();
  u8g2.setDrawColor(1);
  u8g2.setFontPosTop();
  u8g2.setFontDirection(0);
  Serial.println("3");

  // İntro
  u8g2.clearBuffer(); // Display Clear
  u8g2.drawStr( 0, 0,  "Bitirme Projesi");
  u8g2.drawLine(0, 16, 127, 15);
  u8g2.drawStr( 0, 17,  "Ibrahim Ozturk");
  u8g2.drawStr( 0, 32, "Mertcan Yilmaz");
  u8g2.drawStr( 0, 47, "Murat Delibalta");
  u8g2.sendBuffer(); // Display Update
  Serial.println("4");
  delay(800);
}

void loop(void) {
  delay(250);
      while(true) {
        Serial.println("scdsf");
        butonOku();
        saatgoster();
     if ( !Right ) {
      MenuekranBorsa();
     }
     if ( !Left ) {
      MenuekranHakkinda();
     }
     u8g2.sendBuffer(); // u8g2 Update
  }
}

void saatgoster() { 
      u8g2.clearBuffer(); // Display Clear
      Mpu6050(); 
      //u8g2.drawXBMP( 15, 2, 10, 10, alarmlogoanaekran);
      //u8g2.drawXBMP( 0, 2, 10, 10, wifilogo);
      u8g2.drawXBMP( 0, 2, 16, 16, nabizlogoanaekran);
      u8g2.drawXBMP( 0, 16, 16, 16, adimlogoanaekran);
      u8g2.setFont( u8g2_font_10x20_tf);
      u8g2.setCursor( 18, 3);u8g2.print("82");
      u8g2.setCursor( 18, 19);u8g2.print(count);
      u8g2.setFont(u8g2_font_unifont_t_symbols);
      if(alarmaktif == 1){
      u8g2.drawGlyph(110, 1, 0x23f2);}
      if(WiFi.status() == WL_CONNECTED){
      u8g2.drawGlyph(1, 1, 0x2604); }
      u8g2.setFont(u8g2_font_courB24_tf);
      if (  Saat < 10 ) {
      u8g2.setCursor( 62, 10);u8g2.print("0");
      u8g2.setCursor( 82, 10);u8g2.print(Saat);}
      else {
      u8g2.setCursor( 62, 10);u8g2.print(Saat);}
      if (  Dakika < 10 ) {
      u8g2.setCursor( 62, 38);u8g2.print("0");
      u8g2.setCursor( 82, 38);u8g2.print(Dakika);}
      else {
      u8g2.setCursor( 62, 38);u8g2.print(Dakika);}
      u8g2.setFont(u8g2_font_ImpactBits_tr);
            if (  Saniye < 10 ) {
      u8g2.setCursor( 105, 47);u8g2.print("0");
      u8g2.setCursor( 114, 47);u8g2.print(Saniye);}
      else {
      u8g2.setCursor( 105, 47);u8g2.print(Saniye);}
      u8g2.setCursor( 2, 36);
      u8g2.print(Aygunu);
      u8g2.setCursor( 20, 36);
      u8g2.print(aylar[Ay]);
      u8g2.setFont(u8g2_font_helvR08_tf);
      u8g2.setCursor( 2, 51);
      u8g2.print(gunler[Gun]);
      u8g2.sendBuffer(); // u8g2 Update
    //*******************************************************
}

void saathesaplama( void * parameter )
{
  while(true) {
        Saniye++;
       if ( Saniye == 60 ) {
        Saniye=0;
        Dakika++;}
      if ( Dakika == 60 ){
        Dakika=0;
        Saat++;}
       if ( Saat == 24 ){
        Saat=0;
        Gun++; Aygunu++;}
       if ( Gun==8 ){
        Gun=1;}
       if ( Ay == 1 || Ay == 3 || Ay == 5  || Ay == 7  || Ay == 9  || Ay == 11 || Ay == 13 ) 
       { if (Aygunu == 32 ){ Aygunu = 1, Ay++;}}
       if (  Ay == 4 || Ay == 6  || Ay == 8  || Ay == 10 || Ay == 12 ) 
       { if (Aygunu == 31 ){ Aygunu = 1, Ay++;}}
       if ( Ay == 2 ) { if (Aygunu == 30 ) {Aygunu = 1, Ay++;}}
       if ( Ay==13 ) {Yil++, Ay=1;}
       delay(1000);
    //*******************************************************
      }}
void MenuekranBorsa(){
    delay(300);
    while(true) {
      u8g2.clearBuffer(); // Display Clear
      u8g2.drawXBMP( 43, 2, 42, 42, borsalogo);
      u8g2.setFont(u8g2_font_lucasarts_scumm_subtitle_o_tf);
      u8g2.setCursor( 37, 45); u8g2.print("Borsa");
      u8g2.sendBuffer(); // u8g2 Update
    butonOku();
    if ( !Right ) {
      nabiz();
     }
    if ( !Left ) {
      loop();
     }
    if ( !Ok ) {
      bist100();
     }
    if ( !Geri ) {
      loop();
     }
}}
void nabiz (){
  delay(300);
  u8g2.clearBuffer();
  while ( true ) {
    u8g2.drawXBMP( 12, 2, 40, 40, nabizlogo);
    u8g2.drawXBMP( 72, 2, 36, 36, oksijenlogo);
    u8g2.setFont(u8g2_font_crox5tb_tr);
    pox.update();
    if (millis() - tsLastReport > REPORTING_PERIOD_MS) {
        //u8g2.setCursor( 5, 18); u8g2.print("Nabzınız:");
        u8g2.setCursor( 10, 40); u8g2.print(pox.getHeartRate());
        //u8g2.setCursor( 5, 34); u8g2.print("bpm / SpO2:"); 
        u8g2.setCursor( 72, 40); u8g2.print(pox.getSpO2());
        Serial.println(pox.getHeartRate());
         Serial.println(pox.getSpO2());
        u8g2.setFont(u8g2_font_6x13_tf);   
        u8g2.setCursor( 92, 40); u8g2.print("%");
        Serial.println("Beat!");
        tsLastReport = millis();
            butonOku();
    if ( !Right ) {
      adimsayar();}
    if ( !Left ) {
      MenuekranBorsa();
     }
    if ( !Geri ) {
      loop();}
        u8g2.sendBuffer();}
}}
  void onBeatDetected(){}

void adimsayar(){
    delay(300);
  while(true){
    Mpu6050();
    u8g2.clearBuffer();
    u8g2.drawXBMP( 16, 8, 32, 48, adimlogo);
    u8g2.setFont(u8g2_font_lucasarts_scumm_subtitle_o_tf);
    u8g2.setCursor( 65, 26); u8g2.print(count);
    u8g2.sendBuffer();
    butonOku();
     if ( !Right ) {
      sicaklik();}
    if ( !Left ) {
      nabiz();
     }
    if ( !Geri ) {
      loop();}
    }}

void sicaklik(){
    delay(300);
  while(true){
    Mpu6050();
    u8g2.clearBuffer();
    u8g2.drawXBMP( 16, 8, 42, 42, sicakliklogo);
    u8g2.setFont(u8g2_font_lucasarts_scumm_subtitle_o_tf);    
    u8g2.setCursor( 65, 26); u8g2.print(tempe);
    u8g2.sendBuffer();
    butonOku();
     if ( !Right ) {
      MenuekranAlarm();}
    if ( !Left ) {
     adimsayar();
     }
    if ( !Geri ) {
      loop();}
    }}
 
void MenuekranAlarm(){
    delay(300);
  while(true){
    u8g2.clearBuffer();
    u8g2.drawXBMP( 43, 2, 42, 42, alarmlogo);
    u8g2.setFont(u8g2_font_lucasarts_scumm_subtitle_o_tf);
    u8g2.setCursor( 37, 45); u8g2.print("Alarm");
    u8g2.sendBuffer();
    butonOku();
    if ( !Ok ) {
      alarmAyari();}
     if ( !Right ) {
      MenuekranAyarlar();}
    if ( !Left ) {
      sicaklik();
     }
    if ( !Geri ) {
      loop();}
    }} 
        
void MenuekranAyarlar(){
  delay(300);
  while(true){
    u8g2.clearBuffer();
    u8g2.drawXBMP( 43, 2, 42, 42, ayarlarlogo);
    u8g2.setFont(u8g2_font_lucasarts_scumm_subtitle_o_tf);
    u8g2.setCursor( 27, 45); u8g2.print("Ayarlar");
    u8g2.sendBuffer();
    butonOku();
    if ( !Ok ) {
      Ayarlar();}
     if ( !Right ) {
      MenuekranHakkinda();}
    if ( !Left ) {
      MenuekranAlarm();
     }
    if ( !Geri ) {
      loop();}
    }} 

void MenuekranHakkinda () {
  delay(300);
    while ( true ) {
    u8g2.clearBuffer();
    u8g2.drawXBMP( 43, 2, 42, 42, hakkindalogo);
    u8g2.setFont(u8g2_font_lucasarts_scumm_subtitle_o_tf);
    u8g2.setCursor( 20, 45); u8g2.print("Hakkinda");
    u8g2.sendBuffer();
    butonOku();
     if ( !Ok ) {
      Hakkinda ();}
     if ( !Right ) {
      loop();}
    if ( !Left ) {
      MenuekranAyarlar();
     }
    if ( !Geri ) {
      loop();}
    }
}

void Hakkinda () {
  delay(300);
    while ( true ) {
    u8g2.clearBuffer();
    u8g2.setFont(u8g2_font_6x13_tf);
    u8g2.setCursor( 2, 2); u8g2.print("Projeyi Tasarlayanlar:");
    u8g2.setCursor( 2, 12); u8g2.print("Mertcan YILMAZ");
    u8g2.setCursor( 2, 22); u8g2.print("Ibrahim OZTURK");
    u8g2.setCursor( 2, 32); u8g2.print("Murat DELIBALTA");
    u8g2.setCursor( 2, 42); u8g2.print("Tesekkurler");
    u8g2.setCursor( 2, 52); u8g2.print("Zehra Cam TASKIRAN");
    u8g2.sendBuffer();
    butonOku();

    if ( !Geri ) {
      MenuekranHakkinda ();}
    }
}
      
void alarmAyari() {
  Menu = 0;
  delay(300);
  while ( true ) {
    u8g2.clearBuffer();
    u8g2.setFont(u8g2_font_crox2tb_tf);
    u8g2.setCursor( 25, 3);
    u8g2.print("Alarm Ayari");
    u8g2.drawLine(0, 16, 127, 15);
    u8g2.setCursor( 15, 17); u8g2.print("Saat:");
    u8g2.setCursor( 50, 17); u8g2.print(alarmSaat);
    u8g2.setCursor( 15, 32); u8g2.print("Dakika:") ;
    u8g2.setCursor( 75, 32); u8g2.print(alarmDakika);
    u8g2.setCursor( 15, 47); u8g2.print("Alarm:") ;
    if (alarmaktif == 1){
       u8g2.setFont(u8g2_font_unifont_t_symbols);
       u8g2.drawGlyph(75, 47, 0x2714);}
    if (alarmaktif == 0){
       u8g2.setFont(u8g2_font_unifont_t_symbols);
       u8g2.drawGlyph(75, 47, 0x2715); }
    butonOku();
    if ( !Right ) {
      Menu++;
    if ( Menu >= 2 ) Menu = 2;
    }
    if ( !Left ) {
      Menu--;
    if ( Menu <= 0 ) Menu = 0;}
    if ( Menu == 0 ) {
      u8g2.setCursor( 0, 17); u8g2.print(">");
    } else if ( Menu == 1 ) {
      u8g2.setCursor( 0, 32); u8g2.print(">");
    } 
     else if ( Menu == 2 ) {
      u8g2.setCursor( 0, 47); u8g2.print(">");
    }
     u8g2.sendBuffer(); // u8g2 Update
    if  (!Ok ) {
        alarmdegis();
  }
    if ( !Geri ) {
      MenuekranAlarm();
    }
    u8g2.sendBuffer(); // u8g2 Update
  }
}
void alarmdegis(){
    while ( true ) {
    u8g2.clearBuffer();
    u8g2.setFont(u8g2_font_crox2tb_tf);
    u8g2.setCursor( 25, 3);
    u8g2.print("Alarm Ayari");
    u8g2.drawLine(0, 16, 127, 15);
    u8g2.setCursor( 15, 17); u8g2.print("Saat:");
    u8g2.setCursor( 50, 17); u8g2.print(alarmSaat);
    u8g2.setCursor( 15, 32); u8g2.print("Dakika:") ;
    u8g2.setCursor( 75, 32); u8g2.print(alarmDakika);
    u8g2.setCursor( 15, 47); u8g2.print("Alarm:") ;
    if (alarmaktif == 1){
       u8g2.setFont(u8g2_font_unifont_t_symbols);
       u8g2.drawGlyph(75, 47, 0x2714);
    }
        if (alarmaktif == 0){
       u8g2.setFont(u8g2_font_unifont_t_symbols);
       u8g2.drawGlyph(75, 47, 0x2715);
    }
          if ( Menu == 0 ) {
      u8g2.setCursor( 0, 17); u8g2.print("**");
    } else if ( Menu == 1 ) {
      u8g2.setCursor( 0, 32); u8g2.print("**");
    } 
    else if ( Menu == 2 ) {
      u8g2.setCursor( 0, 47); u8g2.print("**");
    } 
       butonOku();              
    if ( !Right ) {
      if ( Menu == 0 )
        alarmSaat++;
      if ( Menu == 1 )
        alarmDakika++;
       if ( Menu == 2 )
        alarmaktif =1;
      if ( alarmSaat > 23 ) alarmSaat = 0;
      if ( alarmDakika > 59 ) alarmDakika = 0;
      delay(100);
    }
    if ( !Left ) {
      if ( Menu == 0 )
        alarmSaat--;
      if ( Menu == 1 )
        alarmDakika--;
       if ( Menu == 2 )
        alarmaktif =0;
      if ( alarmDakika < 0 ) alarmDakika = 23;
      if ( alarmSaat < 0 ) alarmSaat = 59;
      delay(100);
    }
          if ( !Geri ) {
      alarmAyari();
    }
      u8g2.sendBuffer(); // u8g2 Update
}
}

void Ayarlar () {
  Menu = 0;
  delay(300);
  while ( true ) {
    u8g2.clearBuffer();
    u8g2.setFont(u8g2_font_crox2tb_tf);
    u8g2.setCursor( 40, 3);
    u8g2.print("Ayarlar");
    u8g2.drawLine(0, 15, 127, 15);
    u8g2.setCursor( 15, 16); u8g2.print("Saat Ayari");
    u8g2.setCursor( 15, 32); u8g2.print("Tarih Ayari");
    u8g2.setCursor( 15, 47); u8g2.print("Ekran Ayari");  
    butonOku();
    if ( !Right ) {
      Menu++;
      if ( Menu > 2 ) Menu = 2;
      delay(100);
    }
    if ( !Left ) {
      Menu--;
      if ( Menu > 2 ) loop();
      delay(100);
    }    
        if ( Menu == 0 ) {
      u8g2.setCursor( 0, 22); u8g2.print(">");
    } else if ( Menu == 1 ) {
      u8g2.setCursor( 0, 34); u8g2.print(">");
    } else if ( Menu == 2 ) {
      u8g2.setCursor( 0, 46); u8g2.print(">");
    }    
    if ( !Ok ) {
      if ( Menu == 0 ) {
        saatAyari();
      } else if ( Menu == 1 ) {
        tarihAyari();
      } else if ( Menu == 2 ) {
        //ekranAyari();
      }
    }
        if ( !Geri ) {
      MenuekranAyarlar();
    }
    u8g2.sendBuffer(); // u8g2 Update
  }
}

void saatAyari() {
  Menu = 0;
  delay(300);
  while ( true ) {
    u8g2.clearBuffer();
    u8g2.setFont(u8g2_font_crox2tb_tf);
    u8g2.setCursor( 25, 3);
    u8g2.print("Saat Ayarlari");
    u8g2.drawLine(0, 16, 127, 15);    
    u8g2.setCursor( 15, 17); u8g2.print("Saat:");
    u8g2.setCursor( 50, 17); u8g2.print(Saat);
    u8g2.setCursor( 15, 32); u8g2.print("Dakika:") ;
    u8g2.setCursor( 75, 32); u8g2.print(Dakika);
    u8g2.setCursor( 15, 47); u8g2.print("Saniye:");
    u8g2.setCursor( 75, 47); u8g2.print(Saniye);
    butonOku();
    if ( !Right ) {
      Menu++;
      if ( Menu >= 2 ) Menu = 2;
    }
    if ( !Left ) {
      Menu--;
      if ( Menu <= 0 ) Menu = 0;
    } 
      if ( Menu == 0 ) {
      u8g2.setCursor( 0, 17); u8g2.print(">");
    } else if ( Menu == 1 ) {
      u8g2.setCursor( 0, 32); u8g2.print(">");
    } else if ( Menu == 2 ) {
      u8g2.setCursor( 0, 47); u8g2.print(">");
    }
     u8g2.sendBuffer(); // u8g2 Update
    if  (!Ok ) {
        saatdegis();
  }
    if ( !Geri ) {
      Ayarlar();
    }
    u8g2.sendBuffer(); // u8g2 Update
  }
}

void saatdegis() {
  delay(300);
  while ( true ) {
    u8g2.clearBuffer();
    u8g2.setFont(u8g2_font_crox2tb_tf);
    u8g2.setCursor( 25, 3);
    u8g2.print("Saat Ayarlari");
    u8g2.drawLine(0, 16, 127, 15);
    u8g2.setCursor( 15, 17); u8g2.print("Saat:");
    u8g2.setCursor( 50, 17); u8g2.print(Saat);
    u8g2.setCursor( 15, 32); u8g2.print("Dakika:") ;
    u8g2.setCursor( 75, 32); u8g2.print(Dakika);
    u8g2.setCursor( 15, 47); u8g2.print("Saniye:");
    u8g2.setCursor( 75, 47); u8g2.print(Saniye);
      if ( Menu == 0 ) {
      u8g2.setCursor( 0, 17); u8g2.print("**");
    } else if ( Menu == 1 ) {
      u8g2.setCursor( 0, 32); u8g2.print("**");
    } else if ( Menu == 2 ) {
      u8g2.setCursor( 0, 47); u8g2.print("**");
    }
   butonOku();          
    if ( !Right ) {
      
      if ( Menu == 0 )
        Saat++;
      if ( Menu == 1 )
        Dakika++;
      if ( Menu == 2 )
        Saniye++;
      if ( Saat > 23 ) Saat = 0;
      if ( Dakika > 59 ) Dakika = 0;
      if ( Saniye > 59 ) Saniye = 0;
      delay(100);
      
    }
    if ( !Left ) {
      if ( Menu == 0 )
        Saat--;
      if ( Menu == 1 )
        Dakika--;
      if ( Menu == 2 )
        Saniye--;
      if ( Saat < 0 ) Saat = 23;
      if ( Dakika < 0 ) Dakika = 59;
      if ( Saniye < 0 ) Saniye = 59;
      delay(100);
    }
          if ( !Geri ) {
      saatAyari();
    }
      u8g2.sendBuffer(); // u8g2 Update
}
}

void tarihAyari() {
  Menu = 0;
  delay(300);
  while ( true ) {
    u8g2.clearBuffer();
    u8g2.setFont(u8g2_font_crox2tb_tf);
    u8g2.setCursor( 22, 3);
    u8g2.print("Tarih Ayarlari");
    u8g2.drawLine(0, 15, 127, 15);
    u8g2.setCursor( 15, 19); u8g2.print("Gun:");
    u8g2.setCursor( 50, 19); u8g2.print(Gun);
    u8g2.setCursor( 15, 34); u8g2.print("Ay:"); 
    u8g2.setCursor( 50, 34); u8g2.print(Ay);
    u8g2.setCursor( 15, 49); u8g2.print("Yil:");
    u8g2.setCursor( 50, 49); u8g2.print(Yil);
    butonOku();
    if ( !Right ) {
      Menu++;
      if ( Menu >= 2 ) Menu = 2;
    }
    if ( !Left ) {
      Menu--;
      if ( Menu <= 0 ) Menu = 0;
    }
      if ( Menu == 0 ) {
      u8g2.setCursor( 0, 19); u8g2.print(">");
    } else if ( Menu == 1 ) {
      u8g2.setCursor( 0, 34); u8g2.print(">");
    } else if ( Menu == 2 ) {
      u8g2.setCursor( 0, 49); u8g2.print(">");
    }
     u8g2.sendBuffer(); // u8g2 Update
    if  (!Ok ) {
        tarihdegis();
  }
    if ( !Geri ) {
        Ayarlar();
      }
      u8g2.sendBuffer(); // u8g2 Update
    }
  }



void tarihdegis() {
  delay(300);
  while ( true ) {
    u8g2.clearBuffer();
    u8g2.setFont(u8g2_font_crox2tb_tf);
    u8g2.setCursor( 22, 3);
    u8g2.print("Tarih Ayarlari");
    u8g2.drawLine(0, 15, 127, 15);
    u8g2.setCursor( 15, 19); u8g2.print("Gun:");
    u8g2.setCursor( 50, 19); u8g2.print(Gun);
    u8g2.setCursor( 15, 34); u8g2.print("Ay:"); 
    u8g2.setCursor( 50, 34); u8g2.print(Ay);
    u8g2.setCursor( 15, 49); u8g2.print("Yil:");
    u8g2.setCursor( 50, 49); u8g2.print(Yil);
    
    butonOku();
    
      if ( Menu == 0 ) {
      u8g2.setCursor( 0, 19); u8g2.print("**");
    } else if ( Menu == 1 ) {
      u8g2.setCursor( 0, 34); u8g2.print("**");
    } else if ( Menu == 2 ) {
      u8g2.setCursor( 0, 49); u8g2.print("**");
    }
     u8g2.sendBuffer(); // u8g2 Update
  
    if ( !Right ) {
      if ( Menu == 0 )
        Gun++;
      if ( Menu == 1 )
        Ay++;
      if ( Menu == 2 )
        Yil++;
      if ( Gun > 31 ) Gun = 0;
      if ( Ay > 12 ) Ay = 0;
      if ( Yil > 2099 ) Yil = 2000;
      delay(100);
    }
    if ( !Left ) {
      if ( Menu == 0 )
        Gun--;
      if ( Menu == 1 )
        Ay--;
      if ( Menu == 2 )
        Yil--;
      if ( Gun < 0 ) Gun = 31;
      if ( Ay < 0 ) Ay = 12;
      if ( Yil < 2000 ) Yil = 2099;
      delay(100);
    }
    if ( !Geri ) {
        tarihAyari();
      }
      u8g2.sendBuffer(); // u8g2 Update
    }
}



void butonOku () {
  Left  = digitalRead(Left_In);
  Ok    = digitalRead(Ok_In);
  Right = digitalRead(Right_In);
  Geri  =  digitalRead(Geri_In);
  delay(100);
}


void Mpu6050()
{
int error;
  double dT;
  accel_t_gyro_union accel_t_gyro;
  error = read_gyro_accel_vals((uint8_t*) &accel_t_gyro);
  unsigned long t_now = millis();
  
  Serial.print(F("temperature: "));
  dT = ( (double) accel_t_gyro.value.temperature + 12412.0) / 340.0;
  tempe = dT;
  Serial.print(dT, 3);
  Serial.print(F(" degrees Celsius"));
  Serial.println(F(""));
  
  float FS_SEL = 131;
  float gyro_x = (accel_t_gyro.value.x_gyro - base_x_gyro)/FS_SEL;
  float gyro_y = (accel_t_gyro.value.y_gyro - base_y_gyro)/FS_SEL;
  float gyro_z = (accel_t_gyro.value.z_gyro - base_z_gyro)/FS_SEL;
  float accel_x = accel_t_gyro.value.x_accel;
  float accel_y = accel_t_gyro.value.y_accel;
  float accel_z = accel_t_gyro.value.z_accel;
  float RADIANS_TO_DEGREES = 180/3.14159;
  float accel_angle_y = atan(-1*accel_x/sqrt(pow(accel_y,2) + pow(accel_z,2)))*RADIANS_TO_DEGREES;
  float accel_angle_x = atan(accel_y/sqrt(pow(accel_x,2) + pow(accel_z,2)))*RADIANS_TO_DEGREES;
  float accel_angle_z = atan(sqrt(pow(accel_x,2) + pow(accel_y,2))/accel_z)*RADIANS_TO_DEGREES;;
  //float accel_angle_z = 0;
 
  float dt =(t_now - get_last_time())/1000.0;
  float gyro_angle_x = gyro_x*dt + get_last_x_angle();
  float gyro_angle_y = gyro_y*dt + get_last_y_angle();
  float gyro_angle_z = gyro_z*dt + get_last_z_angle();
  float unfiltered_gyro_angle_x = gyro_x*dt + get_last_gyro_x_angle();
  float unfiltered_gyro_angle_y = gyro_y*dt + get_last_gyro_y_angle();
  float unfiltered_gyro_angle_z = gyro_z*dt + get_last_gyro_z_angle();
  float alpha = 0.96;
  float angle_x = alpha*gyro_angle_x + (1.0 - alpha)*accel_angle_x;
  float angle_y = alpha*gyro_angle_y + (1.0 - alpha)*accel_angle_y;
  float angle_z = gyro_angle_z;  //Accelerometer doesn't give z-angle
  set_last_read_angle_data(t_now, angle_x, angle_y, angle_z, unfiltered_gyro_angle_x, unfiltered_gyro_angle_y, unfiltered_gyro_angle_z);
  int mag=sqrt(pow(x-angle_x,2)+pow(y-angle_y,2)+pow(z-angle_z,2));
  
  if(mag>=threshold && prev<threshold)
  {
        count+=1;
    Serial.print("steps= ");
    Serial.println(count);
  }
  prev = mag;
  x=angle_x;
  y=angle_y;
  z=angle_z;
 
  delay(100);
  //Serial.write(10);
}
int MPU6050_read(int start, uint8_t *buffer, int size)
{
  int i, n, error;
  Wire.beginTransmission(MPU6050_I2C_ADDRESS);
  n = Wire.write(start);
  if (n != 1)
    return (-10);
  n = Wire.endTransmission(false);    // hold the I2C-bus
  if (n != 0)
    return (n);
  Wire.requestFrom(MPU6050_I2C_ADDRESS, size, true);
  i = 0;
  while(Wire.available() && i<size)
  {
    buffer[i++]=Wire.read();
  }
  if ( i != size)
    return (-11);
  return (0);  // return : no error
}

int MPU6050_write(int start, const uint8_t *pData, int size)
{
  int n, error;
  Wire.beginTransmission(MPU6050_I2C_ADDRESS);
  n = Wire.write(start);        // write the start address
  if (n != 1)
    return (-20);
  n = Wire.write(pData, size);  // write data bytes
  if (n != size)
    return (-21);
  error = Wire.endTransmission(true); // release the I2C-bus
  if (error != 0)
    return (error);
  return (0);         // return : no error
}

int MPU6050_write_reg(int reg, uint8_t data)
{
  int error;
  error = MPU6050_write(reg, &data, 1);
  return (error);
}

void bist100(){
    delay(300);
  while(true){
    u8g2.clearBuffer();
             if ((WiFi.status() == WL_CONNECTED)) //Check the current connection status
  {
              HTTPClient http;
              http.begin(urlbist100);
              int httpCode = http.GET();
              if (httpCode > 0) {
              String bist100 = http.getString();                                        /* get the return value in string*/   
              bist1001 = bist100.toFloat();                                  
            }
           http.end(); 
        }
    u8g2.drawXBMP( 8, 27, 36, 36, bist100logo);
    u8g2.drawXBMP( 110, 5, 13, 16, tllogo);
    u8g2.setFont(u8g2_font_crox5tb_tf);
    u8g2.setCursor( 5, 5); u8g2.print(bist1001);
    u8g2.setFont( u8g2_font_10x20_tf);
    u8g2.setCursor( 45, 38); u8g2.print("BIST100");
    u8g2.sendBuffer();
    butonOku();
     if ( !Right ) {
      bitcoin();}
    if ( !Left ) {
      dolar();
     }
    if ( !Geri ) {
      MenuekranBorsa();
      }
}}

void dolar(){
    delay(300);
  while(true){
    u8g2.clearBuffer();
         if ((WiFi.status() == WL_CONNECTED)) //Check the current connection status
  {
              HTTPClient http;
              http.begin(urldolar);
              int httpCode = http.GET();
              if (httpCode > 0) {
              String dolar = http.getString();                                        /* get the return value in string*/          
              dolar1 = dolar.toFloat();                           
            }
           http.end(); 
        }
    u8g2.drawXBMP( 8, 27, 36, 36, dolarlogo);
    u8g2.setFont(u8g2_font_crox5tb_tf);
    u8g2.setCursor( 5, 5); u8g2.print(dolar1);
    u8g2.setFont(u8g2_font_inb16_mr);
    u8g2.setCursor( 45, 37); u8g2.print("USD");
    u8g2.sendBuffer();
    butonOku();
     if ( !Right ) {
      bist100();}
    if ( !Left ) {
      euro();
     }
    if ( !Geri ) {
      MenuekranBorsa();}
}}


void euro(){
    delay(300);
  while(true){
    u8g2.clearBuffer();
         if ((WiFi.status() == WL_CONNECTED)) //Check the current connection status
  {
              HTTPClient http;
              http.begin(urleuro);
              int httpCode = http.GET();
              if (httpCode > 0) {
              String euro = http.getString();                                        /* get the return value in string*/   
              euro1 = euro.toFloat();                                  
            }
           http.end(); 
        }
    u8g2.drawXBMP( 8, 27, 36, 36, eurologo);
    u8g2.setFont(u8g2_font_crox5tb_tf);
    u8g2.setCursor( 5, 5); u8g2.print(euro1);
    u8g2.setFont(u8g2_font_inb16_mr);
    u8g2.setCursor( 45, 37); u8g2.print("Euro");
    u8g2.sendBuffer();
    butonOku();
     if ( !Right ) {
      dolar();}
    if ( !Left ) {
      gumusgram();
     }
    if ( !Geri ) {
      MenuekranBorsa();}
}}

void bitcoin(){
    delay(300);
  while(true){
    u8g2.clearBuffer();
         if ((WiFi.status() == WL_CONNECTED)) //Check the current connection status
  {
              HTTPClient http;
              http.begin(urlbtc);
              int httpCode = http.GET();
              if (httpCode > 0) {
              String btc = http.getString();                                        /* get the return value in string*/     
              btc1 = btc.toFloat();                                
            }
           http.end(); 
        }
    u8g2.drawXBMP( 8, 27, 36, 36, bitcoinlogo);
    u8g2.setFont(u8g2_font_crox5tb_tf);
    u8g2.setCursor(5, 5); u8g2.print(btc1);
    u8g2.setFont(u8g2_font_inb16_mr);
    u8g2.setCursor( 45, 37); u8g2.print("BTC");
    u8g2.sendBuffer();
    butonOku();
     if ( !Right ) {
      eth();}
    if ( !Left ) {
      bist100();
     }
    if ( !Geri ) {
      MenuekranBorsa();}
    }}
    
void eth(){
    delay(300);
  while(true){
    u8g2.clearBuffer();
         if ((WiFi.status() == WL_CONNECTED)) //Check the current connection status
  {
              HTTPClient http;
              http.begin(urleth);
              int httpCode = http.GET();
              if (httpCode > 0) {
              String eth = http.getString();                                        /* get the return value in string*/            
              eth1 = eth.toFloat();                         
            }
           http.end(); 
        }
    u8g2.drawXBMP( 8, 27, 36, 36, ethlogo);
    u8g2.setFont(u8g2_font_crox5tb_tf);
    u8g2.setCursor( 5, 5); u8g2.print(eth1);
    u8g2.setFont(u8g2_font_inb16_mr);
    u8g2.setCursor( 45, 37); u8g2.print("ETH");
    u8g2.sendBuffer();
    butonOku();
     if ( !Right ) {
      altin();}
    if ( !Left ) {
      bitcoin();
     }
    if ( !Geri ) {
      MenuekranBorsa();}
    }}
void altin(){
    delay(300);
  while(true){
    u8g2.clearBuffer();
         if ((WiFi.status() == WL_CONNECTED)) //Check the current connection status
  {
              HTTPClient http;
              http.begin(urlaltinons);
              int httpCode = http.GET();
              if (httpCode > 0) {
              String altinons = http.getString();                                        /* get the return value in string*/              
              altinons1 = altinons.toFloat();                       
            }
           http.end(); 
        }
    u8g2.drawXBMP( 8, 27, 36, 36, altinlogo);
    u8g2.setFont(u8g2_font_crox3hb_tf );
    u8g2.setCursor( 5, 5); u8g2.print(altinons1);
    u8g2.setFont(u8g2_font_inb16_mr);
    u8g2.setCursor( 45, 37); u8g2.print("Altin");
    u8g2.sendBuffer();
    butonOku();
     if ( !Right ) {
      altingram();}
    if ( !Left ) {
      eth();
     }
    if ( !Geri ) {
      MenuekranBorsa();}
  }}      

void altingram(){
    delay(300);
  while(true){
    u8g2.clearBuffer();
         if ((WiFi.status() == WL_CONNECTED)) //Check the current connection status
  {
              HTTPClient http;
              http.begin(urlaltingram);
              int httpCode = http.GET();
              if (httpCode > 0) {
              String altingram = http.getString();                                        /* get the return value in string*/             
              altingram1 = altingram.toFloat();                        
            }
           http.end(); 
        }
    u8g2.drawXBMP( 8, 27, 36, 36, altinlogo);
    u8g2.drawXBMP( 100, 5, 13, 16, tllogo);
    u8g2.setFont(u8g2_font_crox5tb_tf);
    u8g2.setCursor( 5, 5); u8g2.print(altingram1);
    u8g2.setFont(u8g2_font_inb16_mr);
    u8g2.setCursor( 45, 37); u8g2.print("Altin");
    u8g2.sendBuffer();
    butonOku();
     if ( !Right ) {
      gumus();}
    if ( !Left ) {
      altin();
     }
    if ( !Geri ) {
      MenuekranBorsa();}
  }}      
  
void gumus(){
    delay(300);
  while(true){
    u8g2.clearBuffer();
     if ((WiFi.status() == WL_CONNECTED)) //Check the current connection status
  {
              HTTPClient http;
              http.begin(urlgumusons);
              int httpCode = http.GET();
              if (httpCode > 0) {
              String gumusons = http.getString();                                        /* get the return value in string*/             
              gumusons1 = gumusons.toFloat();                       
            }
           http.end(); 
        }
    u8g2.drawXBMP( 8, 27, 36, 36, gumuslogo);
    u8g2.setFont(u8g2_font_crox3hb_tf);
    u8g2.setCursor( 5, 5); u8g2.print(gumusons1);
    u8g2.setFont(u8g2_font_inb16_mr);
    u8g2.setCursor( 45, 37); u8g2.print("Gumus");
    u8g2.sendBuffer();
    butonOku();
     if ( !Right ) {
      euro();}
    if ( !Left ) {
      gumusgram();
     }
    if ( !Geri ) {
      MenuekranBorsa();}
}}

void gumusgram(){
    delay(300);
  while(true){
    u8g2.clearBuffer();
     if ((WiFi.status() == WL_CONNECTED)) //Check the current connection status
  {
              HTTPClient http;
              http.begin(urlgumusgram);
              int httpCode = http.GET();
              if (httpCode > 0) {
              String gumusgram = http.getString();                                        /* get the return value in string*/                                   
              gumusgram1 = gumusgram.toFloat();   
            }
           http.end(); 
        }
    u8g2.drawXBMP( 8, 27, 36, 36, gumuslogo);
    u8g2.setFont(u8g2_font_crox5tb_tf);
    u8g2.setCursor( 5, 5); u8g2.print(gumusgram1);
    u8g2.setFont(u8g2_font_inb16_mr);
    u8g2.setCursor( 45, 37); u8g2.print("Gumus");
    u8g2.sendBuffer();
    butonOku();
     if ( !Right ) {
      euro();}
    if ( !Left ) {
     gumus();
     }
    if ( !Geri ) {
      MenuekranBorsa();}
}}

void alert(void * parameter){
    while ( true ) {
if ( alarmSaat == Saat and alarmDakika == Dakika and Saniye == 1 and alarmaktif == 1) {
      for ( i = 1 ; i<11; i++){
      if (i % 2 == 0){
      loop();
    }
      else {
      u8g2.clearBuffer();
      u8g2.setFont(u8g2_font_courB24_tf);
      u8g2.setCursor( 15, 15);u8g2.print("Borsa");
      u8g2.sendBuffer();
    }
      butonOku();
    if ( i == 10 or !Ok) {
        i=11;
        loop();
}
delay(1000);
}}}}

void keepWiFiAlive(void * parameter){
  for(;;){
    if ((WiFi.status() != WL_CONNECTED)){
      WiFi.begin(ssid,pass);
    }
        if ((WiFi.status() != WL_CONNECTED)){
      WiFi.begin(ssidtel,passtel);
    }
    delay(2000);
}}
